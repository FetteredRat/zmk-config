#include "dac_man_5x6.dtsi"

&default_transform {
    col-offset = <6>;
};

&kscan0 {
    col-gpios
        = <&pro_micro_d 22 GPIO_ACTIVE_HIGH>
        , <&pro_micro_d 24 GPIO_ACTIVE_HIGH>
        , <&pro_micro_d 0 GPIO_ACTIVE_HIGH>
        , <&pro_micro_d 11 GPIO_ACTIVE_HIGH>
        , <&pro_micro_d 4 GPIO_ACTIVE_HIGH>
	, <&pro_micro_d 6 GPIO_ACTIVE_HIGH>
        ;
};
